## meta-raspi5-custom/conf/layer.conf
```bitbake
# meta-raspi5-custom layer configuration
# Compatible with Yocto Scarthgap (5.0)

# Layer path & name
BBPATH .= ":${LAYERDIR}"

# Collect all recipes from this layer
BBFILES += "${LAYERDIR}/recipes-*/*/*.bb \
            ${LAYERDIR}/recipes-*/*/*.bbappend"

BBFILE_COLLECTIONS += "raspi5-custom"
BBFILE_PATTERN_raspi5-custom = "^${LAYERDIR}/"
BBFILE_PRIORITY_raspi5-custom = "10"

# Minimum BitBake version required
BB_MIN_VERSION = "2.6"

# This layer depends on:
#   - meta-raspberrypi  (MACHINE = raspberrypi5)
#   - meta-openembedded/meta-oe
#   - meta-openembedded/meta-multimedia
#   - meta-openembedded/meta-python
#   - meta-openembedded/meta-networking
LAYERDEPENDS_raspi5-custom = "core raspberrypi meta-oe meta-python meta-multimedia meta-networking"

LAYERSERIES_COMPAT_raspi5-custom = "scarthgap"
```
